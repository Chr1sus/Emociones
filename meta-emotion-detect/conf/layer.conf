## meta-emotion-detect/conf/layer.conf
```bitbake
# We have a conf and classes directory, add to BBPATH
BBPATH .= ":${LAYERDIR}"

# We have recipes-* directories, add to BBFILES
BBFILES += "${LAYERDIR}/recipes-*/*/*.bb \
            ${LAYERDIR}/recipes-*/*/*.bbappend"

BBFILE_COLLECTIONS += "meta-emotion-detect"
BBFILE_PATTERN_meta-emotion-detect = "^${LAYERDIR}/"
BBFILE_PRIORITY_meta-emotion-detect = "6"

LAYERDEPENDS_meta-emotion-detect = "core"
LAYERSERIES_COMPAT_meta-emotion-detect = "dunfell"
```
